## device-side/target/Config.in
```kconfig
source "tmp/.config-target.in"

# Kernel/Hardware features
config HAS_FPU
	bool

config AUDIO_SUPPORT
	bool

config GPIO_SUPPORT
	bool

config PCI_SUPPORT
	select AUDIO_SUPPORT
	bool

config USB_SUPPORT
	select AUDIO_SUPPORT
	bool

config USB_GADGET_SUPPORT
	bool

config RTC_SUPPORT
	bool

config BIG_ENDIAN
	bool

config USES_DEVICETREE
	bool

config USES_INITRAMFS
	bool

config USES_SQUASHFS
	bool

config USES_JFFS2
	bool

config USES_JFFS2_NAND
	bool

config USES_EXT4
	bool

config USES_TARGZ
	bool

config USES_CPIOGZ
	bool

config USES_UBIFS
	bool
	select NAND_SUPPORT

config PROFILE_KCONFIG
	bool

config LOW_MEMORY_FOOTPRINT
	bool

config NOMMU
	bool

config ARCH_64BIT
	bool

# Architecture selection

config aarch64
	select ARCH_64BIT
	bool

config aarch64_be
	select ARCH_64BIT
	select BIG_ENDIAN
	bool

config arceb
	select BIG_ENDIAN
	bool

config arm
	bool

config armeb
	select BIG_ENDIAN
	bool

config arm_v4
	bool

config arm_v5
	bool

config arm_v6
	bool

config arm_v7
	bool

config ARCH
	string
	default "aarch64"   if aarch64
	default "aarch64_be" if aarch64_be
	default "arm"       if arm
	default "armeb"     if armeb
```

## device-side/target/linux/generic/image/Config.in
```kconfig
config SUNXI_SD_BOOT_PARTSIZE
	int "Boot (SD Card) filesystem partition size (in MB)"
	default 4

config SUNXI_SMALL_STORAGE_OTA
	bool "For storage less than 32M, enable this when using ota"
	default n

config SUNXI_RECOVERY_INITRAMFS_PARTSIZE
        int "Boot-Recovery initramfs filesystem partition size (in MB)"
        default 7
```

## device-side/toolchain/gcc/Config.in
```kconfig
# Choose gcc version.

choice
	prompt "GCC compiler Version" if TOOLCHAINOPTS
	default GCC_USE_VERSION_4_8_ARC if arc
	default GCC_USE_VERSION_5_2_LINARO
	help
	  Select the version of gcc you wish to use.

	config GCC_USE_VERSION_4_8_ARC
		select GCC_VERSION_4_8_ARC
		bool "gcc 4.8.x with support of ARC cores"
		depends on arc

	config GCC_USE_VERSION_4_5_1
		select GCC_VERSION_4_5_1
		bool "gcc 4.5.1"
		depends on !arc

	config GCC_USE_VERSION_4_8_3
		select GCC_VERSION_4_8_3
		bool "gcc 4.8.3"
		depends on !arc

	config GCC_USE_VERSION_5
		select GCC_VERSION_5
		bool "gcc 5.x"
		depends on !arc

	config GCC_USE_VERSION_5_2_LINARO
		select GCC_VERSION_5_2_LINARO
		bool "gcc 5.2.1"
		depends on !arc
endchoice

config GCC_USE_GRAPHITE
	bool
	prompt "Compile in support for the new Graphite framework in GCC 4.4+" if TOOLCHAINOPTS

config GCC_USE_SYSTEM_PPL_CLOOG
	bool
	prompt "Use the system versions of PPL and CLooG"
	depends on GCC_USE_GRAPHITE && GCC_VERSION_4_8
	default n

config EXTRA_GCC_CONFIG_OPTIONS
	string
	prompt "Additional gcc configure options" if TOOLCHAINOPTS
	default ""
	help
	    Any additional gcc options you may want to include....

config SSP_SUPPORT
	bool
	prompt "Enable Stack-Smashing Protection support" if TOOLCHAINOPTS
	depends on !USE_MUSL
	default y if !USE_MUSL
	help
	    Enable Stack-Smashing Protection support

config SJLJ_EXCEPTIONS
	bool
	prompt "Use setjump()/longjump() exceptions" if TOOLCHAINOPTS
	default n
	help
	    Use old setjump()/longjump() exceptions instead of the newer
	    frame unwinding exceptions handling routines.  Warning: increases
	    code size and runtime memory usage.

config INSTALL_LIBGCJ
	bool
	prompt "Build/install java compiler and GNU classpath ?" if TOOLCHAINOPTS
	default n
	help
	    Build/install java compiler and GNU classpath ?


config INSTALL_GFORTRAN
	bool
	prompt "Build/install fortran compiler?" if TOOLCHAINOPTS
	default n
	help
	    Build/install GNU fortran compiler ?
```

## device-side/toolchain/glibc/Config.in
```kconfig
choice
	prompt "(e)glibc version"
	depends on TOOLCHAINOPTS && USE_GLIBC
	default GLIBC_USE_VERSION_2_22
	help
	  Select the version of glibc you wish to use.

	config EGLIBC_USE_VERSION_2_19
		bool "eglibc 2.19"
		depends on BROKEN
		select EGLIBC_VERSION_2_19

	config GLIBC_USE_VERSION_2_18
		bool "glibc 2.18"
		select GLIBC_VERSION_2_18

	config GLIBC_USE_VERSION_2_11
		bool "glibc 2.11"
		select GLIBC_VERSION_2_11

	config GLIBC_USE_VERSION_2_22
		bool "glibc 2.22"
		select GLIBC_VERSION_2_22

endchoice

menu "eglibc configuration"
	depends on TOOLCHAINOPTS && USE_GLIBC && EGLIBC_USE_VERSION_2_19
	source toolchain/glibc/config/Config.in
endmenu
```
